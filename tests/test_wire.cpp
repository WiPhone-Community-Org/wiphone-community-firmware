/*
 * test_wire.cpp — the phone's hand-rolled Meshtastic Data/User codec vs the real
 * protobuf runtime (vectors_wire.h, generated by tools/gen_wire_vectors.py).
 *
 * Byte equality is the bar, not "it round-trips with itself": every other radio on the
 * mesh encodes this with nanopb against upstream's schema, so a field number or a varint
 * width that drifts does not crash anything — it just makes this phone invisible. That is
 * the failure this suite exists to catch, and it is the reason mesh_wire.cpp was lifted
 * out of meshtastic_service.cpp (which drags in the ESP32 SDK and cannot build here).
 *
 * The decode half deliberately feeds in messages carrying fields this firmware does not
 * know. Skipping them is the property that lets Meshtastic keep adding fields without
 * breaking us, and it is worth a test rather than a comment.
 */
#include "../WiPhone/mesh_wire.h"
#include "../WiPhone/neighbor_info.h"   // MESH_PORT_NEIGHBORINFO
#include "../WiPhone/mesh_hash.h"       // meshChannelHash, split out so this can exist
#include "vectors_wire.h"

#include <stdio.h>
#include <string.h>

static int g_pass = 0, g_fail = 0;

static void ok(bool cond, const char* what) {
  if (cond) {
    g_pass++;
  } else {
    g_fail++;
    printf("  \033[31mFAIL\033[0m %s\n", what);
  }
}

static void hexdump(const char* tag, const unsigned char* b, int n) {
  printf("    %s:", tag);
  for (int i = 0; i < n; i++) {
    printf(" %02x", b[i]);
  }
  printf("\n");
}

/* ── PORTNUMS ─────────────────────────────────────────────────────────────────────── */

static void testPortnums() {
  printf("\n\033[1mPortNums still match upstream's portnums.proto\033[0m\n");
  ok(MESH_PORT_TEXT_MESSAGE  == WIRE_UP_PORT_TEXT_MESSAGE,  "TEXT_MESSAGE");
  ok(MESH_PORT_POSITION      == WIRE_UP_PORT_POSITION,      "POSITION");
  ok(MESH_PORT_NODEINFO      == WIRE_UP_PORT_NODEINFO,      "NODEINFO");
  ok(MESH_PORT_ROUTING       == WIRE_UP_PORT_ROUTING,       "ROUTING");
  ok(MESH_PORT_WAYPOINT      == WIRE_UP_PORT_WAYPOINT,      "WAYPOINT");
  ok(MESH_PORT_NEIGHBORINFO  == WIRE_UP_PORT_NEIGHBORINFO,  "NEIGHBORINFO");
}

/* ── CHANNEL HASH ─────────────────────────────────────────────────────────────────── */

static void testChannelHash() {
  printf("\n\033[1mChannel hash matches meshtastic.util.generate_channel_hash\033[0m\n");
  for (int i = 0; i < WIRE_HASH_N; i++) {
    const WireHashVec* v = &WIRE_HASH[i];
    const uint8_t h = meshChannelHash(v->name, v->key, (size_t)v->keyLen);
    char what[96];
    snprintf(what, sizeof(what), "'%s' name='%s' -> 0x%02x (theirs 0x%02x)", v->label, v->name, h, v->hash);
    ok(h == v->hash, what);
  }
  /* The default-channel helper must agree with the LongFast vector, which is what the boot
   * line prints as `'LongFast' hash=0x08`. */
  ok(meshDefaultChannelHash() == WIRE_HASH[0].hash, "meshDefaultChannelHash() == LongFast vector");
  ok(meshDefaultChannelHash() == 0x08, "LongFast is 0x08, as the boot log has always said");
}

/* ── ENCODE ───────────────────────────────────────────────────────────────────────── */

static void testDataEncode() {
  printf("\n\033[1mData protobuf bytes match the real runtime\033[0m\n");
  for (int i = 0; i < WIRE_DATA_N; i++) {
    const WireDataVec* v = &WIRE_DATA[i];
    unsigned char out[512];
    const size_t n = meshBuildData(out, v->portnum, v->payload, (size_t)v->payloadLen,
                                   v->wantResponse != 0, (uint32_t)v->requestId);
    char what[96];
    snprintf(what, sizeof(what), "'%s' length %d == %d", v->label, (int)n, v->len);
    ok((int)n == v->len, what);
    snprintf(what, sizeof(what), "'%s' bytes identical", v->label);
    const bool same = ((int)n == v->len) && memcmp(out, v->bytes, n) == 0;
    ok(same, what);
    if (!same) {
      hexdump("ours", out, (int)n);
      hexdump("theirs", v->bytes, v->len);
    }
  }
}

static void testUserEncode() {
  printf("\n\033[1mUser (NODEINFO) bytes match the real runtime\033[0m\n");
  for (int i = 0; i < WIRE_USER_N; i++) {
    const WireUserVec* v = &WIRE_USER[i];
    unsigned char out[256];
    const size_t n = meshBuildUser(out, (uint32_t)v->nodeNum, v->longName, v->shortName,
                                   v->hasKey ? v->pubKey : NULL);
    char what[96];
    snprintf(what, sizeof(what), "'%s' length %d == %d", v->label, (int)n, v->len);
    ok((int)n == v->len, what);
    snprintf(what, sizeof(what), "'%s' bytes identical", v->label);
    const bool same = ((int)n == v->len) && memcmp(out, v->bytes, n) == 0;
    ok(same, what);
    if (!same) {
      hexdump("ours", out, (int)n);
      hexdump("theirs", v->bytes, v->len);
    }
  }
}

/* ── DECODE ───────────────────────────────────────────────────────────────────────── */

static void testDataDecode() {
  printf("\n\033[1mData parser reads what the real runtime wrote\033[0m\n");
  for (int i = 0; i < WIRE_PARSE_N; i++) {
    const WireParseVec* v = &WIRE_PARSE[i];
    const uint8_t* pl = NULL;
    size_t plLen = 0;
    bool wantResp = false;
    uint32_t reqId = 0;
    const int port = meshParseData(v->bytes, (size_t)v->len, &pl, &plLen, &wantResp, &reqId);
    char what[110];
    snprintf(what, sizeof(what), "'%s' portnum %d == %d", v->label, port, v->portnum);
    ok(port == v->portnum, what);
    snprintf(what, sizeof(what), "'%s' payload length %d == %d", v->label, (int)plLen, v->payloadLen);
    ok((int)plLen == v->payloadLen, what);
    snprintf(what, sizeof(what), "'%s' payload bytes", v->label);
    if (v->payloadLen == 0) {
      /* An ABSENT field 2 (what upstream emits for an empty payload since 0.9.54) leaves
       * `pl` NULL, which is not a failure — it is the case. Consumers gate on `pl && plLen`. */
      ok(plLen == 0, what);
    } else {
      ok(pl && (int)plLen == v->payloadLen && memcmp(pl, v->payload, plLen) == 0, what);
    }
    snprintf(what, sizeof(what), "'%s' want_response %d == %d", v->label, (int)wantResp, v->wantResp);
    ok((int)wantResp == v->wantResp, what);
    snprintf(what, sizeof(what), "'%s' request_id 0x%08lx", v->label, (unsigned long)reqId);
    ok((unsigned long)reqId == v->requestId, what);
  }
}

static void testUserDecode() {
  printf("\n\033[1mUser parser reads what the real runtime wrote\033[0m\n");
  for (int i = 0; i < WIRE_UPARSE_N; i++) {
    const WireUParseVec* v = &WIRE_UPARSE[i];
    char name[64];
    uint8_t key[32];
    bool hasKey = false;
    const bool got = meshParseUserName(v->bytes, (size_t)v->len, name, sizeof(name),
                                       key, &hasKey);
    char what[110];
    snprintf(what, sizeof(what), "'%s' name found", v->label);
    ok(got, what);
    snprintf(what, sizeof(what), "'%s' name '%s' == '%s'", v->label, got ? name : "", v->expectName);
    ok(got && strcmp(name, v->expectName) == 0, what);
    snprintf(what, sizeof(what), "'%s' key present %d == %d", v->label, (int)hasKey, v->hasKey);
    ok((int)hasKey == v->hasKey, what);
    if (v->hasKey) {
      snprintf(what, sizeof(what), "'%s' key bytes", v->label);
      ok(hasKey && memcmp(key, v->expectKey, 32) == 0, what);
    }
  }
}

/* ── HEADER ───────────────────────────────────────────────────────────────────────── */

/* ⚠ NOT AN UPSTREAM-INTEROP TEST, and it must not be mistaken for one. The 16-byte on-air
 * PacketHeader is firmware-internal to Meshtastic (src/mesh/RadioInterface.h) and is NOT in
 * the protobufs, so the python package cannot generate vectors for it. What this checks is
 * OUR side: that the struct is still 16 bytes with the fields where the protocol puts them,
 * and that the flag byte packs hop_limit and hop_start the way the masks say. That catches
 * a padding change, a reordered field or a bad shift — real risks — but it cannot catch
 * upstream changing the header. Verifying that still means reading their C++ source. */
static void testHeaderLayout() {
  printf("\n\033[1mPacketHeader layout and flag packing (ours, not upstream-derived)\033[0m\n");
  ok(sizeof(MeshPacketHeader) == 16, "header is 16 bytes (no padding crept in)");
  ok(MESH_HEADER_LEN == 16, "MESH_HEADER_LEN agrees");

  MeshPacketHeader h;
  memset(&h, 0xAA, sizeof(h));
  meshFillHeader(&h, 0x00449040u, MESH_ADDR_BROADCAST_ONAIR, 0x12345678u, 0x08, 3);
  ok(h.sender == 0x00449040u, "sender");
  ok(h.dest == 0xFFFFFFFFu, "dest is the broadcast address");
  ok(h.packetId == 0x12345678u, "packetId");
  ok(h.channelHash == 0x08, "channelHash (LongFast default is 0x08)");
  ok(h.nextHop == 0, "nextHop zeroed");
  ok(h.relayNode == 0x40, "relayNode is the sender's low byte (we are the first relay)");
  ok((h.flags & MESH_FLAGS_HOP_LIMIT_MASK) == 3, "hop_limit in the low 3 bits");
  ok(((h.flags & MESH_FLAGS_HOP_START_MASK) >> MESH_FLAGS_HOP_START_SHIFT) == 3,
     "hop_start in the top 3 bits");
  ok((h.flags & MESH_FLAGS_WANT_ACK) == 0, "want_ack clear");
  ok((h.flags & MESH_FLAGS_VIA_MQTT) == 0, "via_mqtt clear (private mesh)");

  /* The header is memcpy'd straight off the wire, so the field offsets ARE the protocol. */
  ok(offsetof(MeshPacketHeader, dest) == 0, "dest at offset 0");
  ok(offsetof(MeshPacketHeader, sender) == 4, "sender at offset 4");
  ok(offsetof(MeshPacketHeader, packetId) == 8, "packetId at offset 8");
  ok(offsetof(MeshPacketHeader, flags) == 12, "flags at offset 12");
  ok(offsetof(MeshPacketHeader, channelHash) == 13, "channelHash at offset 13");
  ok(offsetof(MeshPacketHeader, nextHop) == 14, "nextHop at offset 14");
  ok(offsetof(MeshPacketHeader, relayNode) == 15, "relayNode at offset 15");

  /* A hop limit of 7 is the widest the 3-bit field holds; 8 must not bleed into hop_start. */
  meshFillHeader(&h, 1, 2, 3, 0, 7);
  ok((h.flags & MESH_FLAGS_HOP_LIMIT_MASK) == 7, "hop_limit 7 fits");
  ok(((h.flags & MESH_FLAGS_HOP_START_MASK) >> MESH_FLAGS_HOP_START_SHIFT) == 7, "hop_start 7 fits");
}

/* ── HAND-CRAFTED ROBUSTNESS ──────────────────────────────────────────────────────────
 * ⚠ NOT upstream-derived, and deliberately so: upstream's own runtime CANNOT emit either
 * of these shapes, so no generated vector can cover them.
 *   - Data/User carry no fixed64 field anywhere in the schema, so the `i += 8` (wire type 1)
 *     branch in both parsers had zero coverage — deleting it passed the whole suite.
 *   - proto3 omits an empty string, so a present-but-empty long_name (`12 00`) is
 *     unreachable from python. It is reachable from the air: this firmware emitted exactly
 *     that until 0.9.54, and any other hand-rolled implementation may still.
 * These bytes are written out by hand for that reason. */
static void testHandCrafted() {
  printf("\n\033[1mHand-crafted shapes upstream cannot emit (ours, not upstream-derived)\033[0m\n");

  /* portnum=1, then an UNKNOWN fixed64 (field 15, wire type 1), then the payload. Reading
   * the payload at all proves the parser stepped over all 8 bytes and no fewer. */
  static const uint8_t withFixed64[] = {
    0x08, 0x01,                                            // field 1 portnum = 1
    0x79, 0xDE,0xAD,0xBE,0xEF,0x01,0x02,0x03,0x04,         // field 15, wire 1 (fixed64)
    0x12, 0x05, 'h','e','l','l','o',                       // field 2 payload
  };
  const uint8_t* pl = NULL; size_t plLen = 0;
  int port = meshParseData(withFixed64, sizeof(withFixed64), &pl, &plLen, NULL, NULL);
  ok(port == 1, "fixed64 skip: portnum still 1");
  ok(plLen == 5 && pl && memcmp(pl, "hello", 5) == 0, "fixed64 skip: payload read after it");

  /* Same for the User parser: an unknown fixed32 (field 15, wire 5) ahead of the name. */
  static const uint8_t userFixed32[] = {
    0x0a, 0x03, '!','a','b',                               // field 1 id
    0x7d, 0x11,0x22,0x33,0x44,                             // field 15, wire 5 (fixed32)
    0x1a, 0x04, 'S','H','R','T',                           // field 3 short_name
  };
  char name[64]; uint8_t key[32]; bool hasKey = true;
  ok(meshParseUserName(userFixed32, sizeof(userFixed32), name, sizeof(name), key, &hasKey),
     "User fixed32 skip: a name was found");
  ok(strcmp(name, "SHRT") == 0, "User fixed32 skip: short_name read after it");
  ok(!hasKey, "User fixed32 skip: no key claimed");

  /* A present-but-EMPTY long_name must not suppress the short_name fallback. This is the
   * exact packet 0.9.53 and earlier put on the air. */
  static const uint8_t emptyLong[] = {
    0x0a, 0x03, '!','a','b',                               // field 1 id
    0x12, 0x00,                                            // field 2 long_name = "" (present)
    0x1a, 0x04, 'F','B','C','K',                           // field 3 short_name
  };
  ok(meshParseUserName(emptyLong, sizeof(emptyLong), name, sizeof(name), NULL, NULL),
     "empty long_name: a name was still found");
  ok(strcmp(name, "FBCK") == 0, "empty long_name: fell back to short_name");

  /* ⚠ A SHORT public_key WITH ENOUGH BYTES BEHIND IT. The generated `uparse_key_wrong_len`
   * vector turned out to be VACUOUS: its 16-byte key sits near the end, so the separate
   * `i + 32 <= dlen` bounds check rejected it even with the length guard deleted, and the
   * mutation passed 125/125. Here the key is followed by a long trailing field, so only the
   * `l == MESH_PKI_KEY_LEN` test can reject it — without that guard the parser memcpy's 32
   * bytes over a 16-byte field and hands back a WRONG key, which is a silently undeliverable
   * DM rather than a visible failure. */
  static const uint8_t shortKeyPadded[] = {
    0x0a, 0x03, '!','a','b',                               // field 1 id
    0x42, 0x10,                                            // field 8 public_key, LENGTH 16
      0,1,2,3,4,5,6,7,8,9,10,11,12,13,14,15,
    0x1a, 0x04, 'S','H','R','T',                           // field 3 short_name
    0x52, 0x18,                                            // field 10, 24 bytes of padding
      0,0,0,0,0,0,0,0,0,0,0,0,0,0,0,0,0,0,0,0,0,0,0,0,
  };
  hasKey = true;
  ok(meshParseUserName(shortKeyPadded, sizeof(shortKeyPadded), name, sizeof(name),
                       key, &hasKey), "short key: a name was still found");
  ok(strcmp(name, "SHRT") == 0, "short key: short_name read");
  ok(!hasKey, "short key: a 16-byte public_key is REJECTED, not padded to 32");

  /* A TEN-BYTE VARINT in an unknown field, then the payload. protobuf encodes a negative
   * int32 this way; Data has no such field so upstream cannot generate one, but a malformed
   * or future packet can carry it, and the reader used to shift a uint32 by up to 63 (UB).
   * Reaching the payload proves all ten bytes were consumed; UBSan proves no bad shift. */
  static const uint8_t tenByteVarint[] = {
    0x08, 0x01,                                            // field 1 portnum = 1
    0x78, 0xce,0xff,0xff,0xff,0xff,0xff,0xff,0xff,0xff,0x01, // field 15 varint = -50 (10 bytes)
    0x12, 0x02, 'o','k',                                   // field 2 payload
  };
  pl = NULL; plLen = 0;
  port = meshParseData(tenByteVarint, sizeof(tenByteVarint), &pl, &plLen, NULL, NULL);
  ok(port == 1, "10-byte varint: portnum still 1");
  ok(plLen == 2 && pl && memcmp(pl, "ok", 2) == 0, "10-byte varint: payload read after it");

  /* And with nothing usable at all, it must report failure rather than an empty string. */
  static const uint8_t bothEmpty[] = { 0x0a, 0x03, '!','a','b', 0x12, 0x00, 0x1a, 0x00 };
  ok(!meshParseUserName(bothEmpty, sizeof(bothEmpty), name, sizeof(name), NULL, NULL),
     "both names empty: reports no name");
}

int main() {
  printf("built against meshtastic %s\n", WIRE_VEC_MESHTASTIC_VERSION);
  testPortnums();
  testChannelHash();
  testDataEncode();
  testUserEncode();
  testDataDecode();
  testUserDecode();
  testHeaderLayout();
  testHandCrafted();
  printf("\n%s%d passed, %d failed\033[0m\n", g_fail ? "\033[31m" : "\033[32m", g_pass, g_fail);
  return g_fail ? 1 : 0;
}
