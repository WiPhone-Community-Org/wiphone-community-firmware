/*
 * test_inbox.cpp — the parking spot for positions that arrive before you open the book.
 *
 * The two behaviours worth guarding are both silent when wrong:
 *
 *   - a packet signed with SOMEBODY ELSE'S passcode must be taken out of the Chats list (it
 *     is machine traffic, not a message) and must never, ever be applied; and
 *   - a position that arrives while the book is shut must still be there when it is opened,
 *     because a LoRa round trip does not fit inside the moment you press Sync.
 *
 * Packets here are the real ones from the interop vectors, generated by running COVEY's own
 * booksync.py — so this exercises the same bytes the radio will carry.
 */
#include "../WiPhone/booksync_inbox.h"
#include "vectors_booksync.h"

#include <stdio.h>
#include <string.h>

static int g_pass = 0, g_fail = 0;
static const char* g_group = "";

static void group(const char* name) {
  g_group = name;
  printf("\n\033[1m%s\033[0m\n", name);
}

static void ok(bool cond, const char* what) {
  if (cond) {
    g_pass++;
  } else {
    g_fail++;
    printf("  \033[31mFAIL\033[0m %s :: %s\n", g_group, what);
  }
}

static void eqU32(unsigned long got, unsigned long want, const char* what) {
  if (got == want) {
    g_pass++;
    return;
  }
  g_fail++;
  printf("  \033[31mFAIL\033[0m %s :: %s  want=%lu got=%lu\n", g_group, what, want, got);
}

// The first record vector, which is a full real packet with known contents.
static const BsRecVec* recVec(const char* label) {
  for (int i = 0; i < BS_REC_VEC_N; i++) {
    if (strcmp(BS_REC_VECS[i].label, label) == 0) {
      return &BS_REC_VECS[i];
    }
  }
  return NULL;
}

static void keyFor(const char* passcode, uint8_t key[32]) {
  bookSyncDeriveKey(passcode, key);
}

static void testParkAndFind() {
  group("a position parked before the book is opened is still there after");

  const BsRecVec* v = &BS_REC_VECS[0];
  uint8_t key[32];
  keyFor(v->passcode, key);

  bookSyncInboxInit();
  eqU32((unsigned long)bookSyncInboxCount(), 0, "starts empty");

  ok(bookSyncInboxPush(v->meshText, 0x1234abcd, 1000), "a real packet parks");
  eqU32((unsigned long)bookSyncInboxCount(), 1, "one parked");

  // The book is opened later and asks for anything about it.
  const char* ids[1] = { v->reducedId };
  BookSyncRecord got;
  uint32_t from = 0;
  int idx = bookSyncInboxFindFor(key, ids, 1, &got, &from);
  ok(idx == 0, "found once the book is open");
  eqU32(got.spine, v->reducedSpine, "spine survived the wait");
  eqU32(got.offset, v->reducedOffset, "offset survived the wait");
  eqU32(from, 0x1234abcd, "and we know who sent it");

  ok(bookSyncInboxCount() == 1, "finding does not consume it");
  bookSyncInboxRemove(idx);
  eqU32((unsigned long)bookSyncInboxCount(), 0, "acting on it does");
}

static void testWrongPasscodeIsDivertedButNeverApplied() {
  group("someone else's passcode: out of Chats, and never applied");

  bookSyncInboxInit();
  for (int i = 0; i < (int)(sizeof(BS_BAD_VECS) / sizeof(BS_BAD_VECS[0])); i++) {
    const BsBadVec* b = &BS_BAD_VECS[i];
    bool parked = bookSyncInboxPush(b->text, 1, 100);
    bool looksLikeSync = bookSyncIsSyncText(b->text);
    char what[96];
    snprintf(what, sizeof(what), "%s: parked exactly when it looks like sync traffic",
             b->label);
    ok(parked == looksLikeSync, what);
  }
  ok(bookSyncInboxCount() > 0, "some of them WERE diverted out of the chat list");

  /* Every one of them must fail to match under the honest key: they are either malformed or
   * signed with a different passcode. This is the assertion that stops a stranger moving
   * your place in a book. */
  uint8_t key[32];
  keyFor("vector-passcode-a", key);
  const char* ids[1] = { BS_REC_VECS[0].reducedId };
  BookSyncRecord got;
  int idx = bookSyncInboxFindFor(key, ids, 1, &got, NULL);
  ok(idx < 0, "and not one of them matches");
}

static void testNewestWins() {
  group("the newest reading event wins, not the newest arrival");

  uint8_t key[32];
  keyFor("vector-passcode-a", key);
  const char* ids[1] = { "id:some-book" };

  BookSyncRecord a, b;
  bookSyncMakeRecord(&a, ids, 1, 3, 100, 0.25, 1000, "COVEY", "aaaaaaaa");
  bookSyncMakeRecord(&b, ids, 1, 7, 900, 0.75, 5000, "COVEY", "bbbbbbbb");
  char ta[BOOKSYNC_MESH_TEXT_MAX], tb[BOOKSYNC_MESH_TEXT_MAX];
  ok(bookSyncPackMesh(&a, key, ta, sizeof(ta)), "packed the older one");
  ok(bookSyncPackMesh(&b, key, tb, sizeof(tb)), "packed the newer one");

  // Park the NEWER one first, so arrival order is the opposite of reading order.
  bookSyncInboxInit();
  bookSyncInboxPush(tb, 1, 500);
  bookSyncInboxPush(ta, 1, 900);

  BookSyncRecord got;
  int idx = bookSyncInboxFindFor(key, ids, 1, &got, NULL);
  ok(idx >= 0, "one of them matches");
  eqU32(got.spine, 7, "the later page turn wins despite arriving first");
  eqU32(got.turnedAt, 5000, "and it is the later turnedAt");
}

static void testHousekeeping() {
  group("the inbox does not fill up with the same news");

  uint8_t key[32];
  keyFor("vector-passcode-a", key);
  const char* ids[1] = { "id:dupe-book" };
  BookSyncRecord r;
  bookSyncMakeRecord(&r, ids, 1, 1, 2, 0.5, 77, "COVEY", "cccccccc");
  char text[BOOKSYNC_MESH_TEXT_MAX];
  bookSyncPackMesh(&r, key, text, sizeof(text));

  bookSyncInboxInit();
  for (int i = 0; i < 10; i++) {
    bookSyncInboxPush(text, 1, 100 + i);
  }
  eqU32((unsigned long)bookSyncInboxCount(), 1, "a resend replaces rather than stacks");

  // Different books must not push each other out until the inbox is genuinely full.
  bookSyncInboxInit();
  for (int i = 0; i < BOOKSYNC_INBOX_MAX + 2; i++) {
    char id[32];
    snprintf(id, sizeof(id), "id:book-%d", i);
    const char* one[1] = { id };
    BookSyncRecord x;
    bookSyncMakeRecord(&x, one, 1, (unsigned)i, 0, 0.1, 10 + i, "COVEY", "dddddddd");
    char t[BOOKSYNC_MESH_TEXT_MAX];
    bookSyncPackMesh(&x, key, t, sizeof(t));
    bookSyncInboxPush(t, 1, 200 + i);
  }
  eqU32((unsigned long)bookSyncInboxCount(), BOOKSYNC_INBOX_MAX, "capped");

  // The oldest went; the newest stayed.
  const char* newest[1] = { "id:book-5" };
  BookSyncRecord got;
  ok(bookSyncInboxFindFor(key, newest, 1, &got, NULL) >= 0, "the newest book is still parked");
  const char* oldest[1] = { "id:book-0" };
  ok(bookSyncInboxFindFor(key, oldest, 1, &got, NULL) < 0, "the oldest was evicted");

  ok(!bookSyncInboxPush("just a normal chat message", 1, 1), "a chat message is not parked");
  ok(!bookSyncInboxPush(NULL, 1, 1), "and neither is nothing");
}

/* The doorbell. The reading screen polls bookSyncInboxSeq() once a second and only does the
 * expensive verify when it moves, so if this counter is wrong in either direction the symptom
 * is silent: either the offer never appears while you are reading, or it re-appears on a mesh
 * rebroadcast of a position you are already looking at. */
static void testSeqIsTheDoorbell() {
  group("the change counter the reader polls");

  uint8_t key[32];
  keyFor("vector-passcode-a", key);
  const char* ids[1] = { "id:doorbell-book" };

  char first[BOOKSYNC_MESH_TEXT_MAX], again[BOOKSYNC_MESH_TEXT_MAX];
  BookSyncRecord r;
  bookSyncMakeRecord(&r, ids, 1, 2, 40, 0.20, 1000, "COVEY", "eeeeeeee");
  bookSyncPackMesh(&r, key, first, sizeof(first));
  // A second press of Sync over there: same book, later page turn, its own nonce.
  BookSyncRecord r2;
  bookSyncMakeRecord(&r2, ids, 1, 5, 90, 0.55, 2000, "COVEY", "ffffffff");
  bookSyncPackMesh(&r2, key, again, sizeof(again));

  bookSyncInboxInit();
  uint32_t seq = bookSyncInboxSeq();
  ok(bookSyncInboxSeq() == seq, "quiet air does not move it");

  ok(bookSyncInboxPush(first, 1, 100), "a position arrives");
  ok(bookSyncInboxSeq() != seq, "and the reader is told to look");
  seq = bookSyncInboxSeq();

  /* Flood routing means we hear the same frame more than once. That is the same news, and
   * raising the card again for it would be a nag, not a sync. */
  ok(bookSyncInboxPush(first, 1, 101), "the same frame arrives again");
  ok(bookSyncInboxSeq() == seq, "a rebroadcast does NOT ring the doorbell");

  ok(bookSyncInboxPush(again, 1, 200), "they press Sync a second time");
  ok(bookSyncInboxSeq() != seq, "a deliberate resend does");
  seq = bookSyncInboxSeq();

  ok(!bookSyncInboxPush("just a normal chat message", 1, 1), "a chat message is refused");
  ok(bookSyncInboxSeq() == seq, "and does not ring it either");

  /* Two positions are parked for this book. Acting on one must make the reader look again,
   * or the second stays invisible until the book is closed and opened. */
  BookSyncRecord got;
  int idx = bookSyncInboxFindFor(key, ids, 1, &got, NULL);
  ok(idx >= 0, "the newer of the two is offered first");
  eqU32(got.spine, 5, "and it is the later page turn");
  ok(bookSyncInboxSeq() == seq, "looking is not a change");

  bookSyncInboxRemove(idx);
  ok(bookSyncInboxSeq() != seq, "taking one out rings it, so the other is found");
  ok(bookSyncInboxFindFor(key, ids, 1, &got, NULL) >= 0, "and the other one is still there");
  eqU32(got.spine, 2, "which is the earlier position");
}

static void testWrongBook() {
  group("a position for another book is left alone");

  const BsRecVec* v = &BS_REC_VECS[0];
  uint8_t key[32];
  keyFor(v->passcode, key);
  bookSyncInboxInit();
  bookSyncInboxPush(v->meshText, 1, 10);

  const char* other[1] = { "id:a-different-book-entirely" };
  BookSyncRecord got;
  ok(bookSyncInboxFindFor(key, other, 1, &got, NULL) < 0, "no match for the wrong book");
  eqU32((unsigned long)bookSyncInboxCount(), 1, "and it stays parked for the right one");
}


/* ---------------------------------------------------------------- stacking

   {user}, 2026-09-05: "when I sync my place on a device and then do that multiple times
   without checking it each time on the wiphone (stacking sync messages) it sometimes gets
   confused on which one of the places to sync to. It doesn't happen all the time though."

   Three separate faults, all of which need MORE THAN ONE packet parked to show up — which is
   why testNewestWins() (two packets, stamps 1000 vs 5000, clearly ordered) never saw any of
   them. The "sometimes" is whether the sender had a clock. */

// Park n positions for one book with the given turnedAt values; returns the ids assigned.
static void parkStack(const uint8_t key[32], const char* const* ids, int nIds,
                      const uint32_t* turnedAt, const uint32_t* spines, int n,
                      uint32_t* idsOut) {
  for (int i = 0; i < n; i++) {
    BookSyncRecord r;
    char nonce[BOOKSYNC_NONCE_CHARS + 1];
    for (int k = 0; k < BOOKSYNC_NONCE_CHARS; k++) {
      nonce[k] = (char)('a' + ((i + k) % 16 < 10 ? (i + k) % 10 : 0));
    }
    nonce[BOOKSYNC_NONCE_CHARS] = '\0';
    snprintf(nonce, sizeof(nonce), "%08x", (unsigned)(0x1000 + i));
    bookSyncMakeRecord(&r, ids, nIds, spines[i], 100 + i, 0.1 * (i + 1), turnedAt[i],
                       "SENDER", nonce);
    char t[BOOKSYNC_MESH_TEXT_MAX];
    ok(bookSyncPackMesh(&r, key, t, sizeof(t)), "packed a stacked position");
    ok(bookSyncInboxPush(t, 1, 100 + i), "parked it");
    if (idsOut) {
      idsOut[i] = bookSyncInboxIdAt(bookSyncInboxCount() - 1);
    }
  }
}

static void testTiedTurnedAtTakesTheLatest() {
  group("a tie on turnedAt takes the LATEST parked, not the earliest");

  uint8_t key[32];
  keyFor("vector-passcode-a", key);
  const char* ids[1] = { "id:stacking-book" };

  /* Pressing Sync again on COVEY mints a new nonce but NOT a new turnedAt — _turned_at only
   * moves on a page turn (books.py) — so a stack of taps is a stack of ties. */
  const uint32_t sameStamp[3] = { 4242, 4242, 4242 };
  const uint32_t spines[3] = { 1, 2, 3 };
  bookSyncInboxInit();
  parkStack(key, ids, 1, sameStamp, spines, 3, NULL);
  eqU32((unsigned long)bookSyncInboxCount(), 3, "all three parked (different nonces)");

  BookSyncRecord got;
  ok(bookSyncInboxFindFor(key, ids, 1, &got, NULL) >= 0, "one of them is offered");
  eqU32(got.spine, 3, "the LAST one synced wins the tie, not the first");
}

static void testNoClockMeansEverythingTies() {
  group("turnedAt == 0 (sender has no NTP) still offers the newest sync");

  uint8_t key[32];
  keyFor("vector-passcode-a", key);
  const char* ids[1] = { "id:stacking-book" };

  /* sendMyPlace() stamps 0 whenever ntpClock.isTimeKnown() is false, and NTP over WiFi is
   * the only clock this phone has. Off-grid — which is what LoRa reading IS — every packet a
   * WiPhone sends carries 0, so the whole stack ties and ordering falls to arrival. */
  const uint32_t noClock[3] = { 0, 0, 0 };
  const uint32_t spines[3] = { 5, 6, 7 };
  bookSyncInboxInit();
  parkStack(key, ids, 1, noClock, spines, 3, NULL);

  BookSyncRecord got;
  ok(bookSyncInboxFindFor(key, ids, 1, &got, NULL) >= 0, "an unstamped stack still matches");
  eqU32(got.spine, 7, "and the most recently arrived is the one offered");
  eqU32(got.turnedAt, 0, "with its stamp left at 0, not invented");
}

static void testARealStampStillBeatsArrivalOrder() {
  group("two real stamps still order by the page turn, not by arrival");

  uint8_t key[32];
  keyFor("vector-passcode-a", key);
  const char* ids[1] = { "id:stacking-book" };

  // The original contract, which the tie fix must not have broken: newer turn, parked FIRST.
  const uint32_t stamps[2] = { 9000, 1000 };
  const uint32_t spines[2] = { 11, 22 };
  bookSyncInboxInit();
  parkStack(key, ids, 1, stamps, spines, 2, NULL);

  BookSyncRecord got;
  ok(bookSyncInboxFindFor(key, ids, 1, &got, NULL) >= 0, "matched");
  eqU32(got.spine, 11, "the later page turn wins despite arriving first");
  eqU32(got.turnedAt, 9000, "and it is the later turnedAt");
}

static void testIdSurvivesTheArrayShifting() {
  group("an id still names the right packet after eviction shifts the array");

  uint8_t key[32];
  keyFor("vector-passcode-a", key);
  const char* ids[1] = { "id:stacking-book" };

  const uint32_t stamps[4] = { 10, 20, 30, 40 };
  const uint32_t spines[4] = { 1, 2, 3, 4 };
  uint32_t parked[4];
  bookSyncInboxInit();
  parkStack(key, ids, 1, stamps, spines, 4, parked);
  eqU32((unsigned long)bookSyncInboxCount(), 4, "inbox full");

  /* The reader has chosen the spine-3 packet and is showing a card. Its INDEX is 2. */
  int idxAtChoice = 2;
  uint32_t chosen = parked[2];
  eqU32(bookSyncInboxIdAt(idxAtChoice), chosen, "index 2 is the chosen packet, for now");

  // A fifth lands while the card is up. Eviction shifts everything down one.
  const uint32_t late[1] = { 50 };
  const uint32_t lateSpine[1] = { 9 };
  parkStack(key, ids, 1, late, lateSpine, 1, NULL);
  eqU32((unsigned long)bookSyncInboxCount(), 4, "still capped at four");
  ok(bookSyncInboxIdAt(idxAtChoice) != chosen, "index 2 now names a DIFFERENT packet");

  // Removing by the old index would destroy the wrong one. By id, it does not.
  ok(bookSyncInboxRemoveId(chosen), "the id still finds the packet the reader chose");
  eqU32((unsigned long)bookSyncInboxCount(), 3, "and removed exactly one");
  for (int i = 0; i < bookSyncInboxCount(); i++) {
    ok(bookSyncInboxIdAt(i) != chosen, "the chosen packet is really gone");
  }
  ok(!bookSyncInboxRemoveId(chosen), "removing it twice is a no-op, not a corruption");
}

static void testActingOnOneRetiresTheWholeStack() {
  group("taking a position retires the whole stack for that book");

  uint8_t key[32];
  keyFor("vector-passcode-a", key);
  const char* book[1] = { "id:stacking-book" };
  const char* other[1] = { "id:some-other-book" };

  bookSyncInboxInit();
  const uint32_t stamps[3] = { 100, 200, 300 };
  const uint32_t spines[3] = { 1, 2, 3 };
  parkStack(key, book, 1, stamps, spines, 3, NULL);

  // ...and one for a DIFFERENT book, which must survive.
  const uint32_t oStamp[1] = { 150 };
  const uint32_t oSpine[1] = { 77 };
  parkStack(key, other, 1, oStamp, oSpine, 1, NULL);
  eqU32((unsigned long)bookSyncInboxCount(), 4, "three for one book, one for another");

  BookSyncRecord got;
  ok(bookSyncInboxFindFor(key, book, 1, &got, NULL) >= 0, "the newest is offered");
  eqU32(got.spine, 3, "which is the last place synced");

  /* The reader acts. Before the fix it removed ONE packet and the next tick offered spine 2,
   * then spine 1 — walking backwards through places already left. */
  eqU32((unsigned long)bookSyncInboxDropForBook(key, book, 1), 3, "all three retired at once");
  ok(bookSyncInboxFindFor(key, book, 1, &got, NULL) < 0, "nothing left to nag with");

  eqU32((unsigned long)bookSyncInboxCount(), 1, "and the other book is untouched");
  ok(bookSyncInboxFindFor(key, other, 1, &got, NULL) >= 0, "still offered for its own book");
  eqU32(got.spine, 77, "with its own position intact");
}

static void testRetiredPacketDoesNotWalkBackIn() {
  group("the sender's second copy does not re-raise a card already dealt with");

  uint8_t key[32];
  keyFor("vector-passcode-a", key);
  const char* ids[1] = { "id:stacking-book" };

  /* COVEY sends every record TWICE, 7 s apart, byte-identical (books.py retransmits while
   * _mesh_sends < 2; booksync.py MESH_REPEAT_S = 7.0). The dedup only scans what is parked,
   * so once the reader acted and the packet was removed, the second copy used to park itself
   * and put the identical card straight back up. */
  BookSyncRecord r;
  bookSyncMakeRecord(&r, ids, 1, 4, 100, 0.4, 7777, "COVEY", "cafebabe");
  char t[BOOKSYNC_MESH_TEXT_MAX];
  ok(bookSyncPackMesh(&r, key, t, sizeof(t)), "packed a position");

  bookSyncInboxInit();
  ok(bookSyncInboxPush(t, 1, 10), "first copy parks");
  eqU32((unsigned long)bookSyncInboxCount(), 1, "one parked");

  BookSyncRecord got;
  int idx = bookSyncInboxFindFor(key, ids, 1, &got, NULL);
  ok(idx >= 0, "it is offered");
  bookSyncInboxRemove(idx);                    // the reader accepts, or declines
  eqU32((unsigned long)bookSyncInboxCount(), 0, "and it is retired");

  // 7 seconds later, the sender's identical second copy arrives.
  ok(bookSyncInboxPush(t, 1, 17), "the repeat is still recognised as a sync packet");
  eqU32((unsigned long)bookSyncInboxCount(), 0, "but it does NOT come back as a new offer");
  ok(bookSyncInboxFindFor(key, ids, 1, &got, NULL) < 0, "so no card is raised again");

  /* ...while pressing Sync again on the sender IS news: a fresh nonce is a different packet. */
  bookSyncMakeRecord(&r, ids, 1, 9, 200, 0.9, 8888, "COVEY", "d00dfeed");
  char t2[BOOKSYNC_MESH_TEXT_MAX];
  ok(bookSyncPackMesh(&r, key, t2, sizeof(t2)), "packed a deliberate resync");
  ok(bookSyncInboxPush(t2, 1, 30), "which parks normally");
  ok(bookSyncInboxFindFor(key, ids, 1, &got, NULL) >= 0, "and is offered");
  eqU32(got.spine, 9, "at the new place");
}

int main() {
  (void)recVec;
  testParkAndFind();
  testWrongPasscodeIsDivertedButNeverApplied();
  testNewestWins();
  testHousekeeping();
  testSeqIsTheDoorbell();
  testWrongBook();
  testTiedTurnedAtTakesTheLatest();
  testNoClockMeansEverythingTies();
  testARealStampStillBeatsArrivalOrder();
  testIdSurvivesTheArrayShifting();
  testActingOnOneRetiresTheWholeStack();
  testRetiredPacketDoesNotWalkBackIn();
  printf("\n%s%d passed, %d failed\033[0m\n", g_fail ? "\033[31m" : "\033[32m", g_pass, g_fail);
  return g_fail ? 1 : 0;
}
