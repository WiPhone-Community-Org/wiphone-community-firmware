/*
 * test_booksync.cpp — proves the WiPhone's booksync port is byte-identical to COVEY's.
 *
 * Runs on the Mac (tests/run_tests.sh), against the SAME source files the phone builds, so
 * a pass here means the shipping bytes are right — not a parallel implementation's bytes.
 *
 * Two kinds of vector:
 *   - BS_*_VECS  come from tests/vectors_booksync.h, GENERATED by running COVEY's real
 *     booksync.py. These are the interop contract.
 *   - The hash/base32 vectors below are the published NIST / RFC 4231 ones, so a failure
 *     separates "my SHA-256 is wrong" from "my protocol framing is wrong". Without them a
 *     broken primitive would present as a mysterious mac mismatch.
 */
#include "../WiPhone/book_hash.h"
#include "../WiPhone/booksync.h"
#include "vectors_booksync.h"

#include <stdio.h>
#include <string.h>
#include <stdlib.h>

static int g_pass = 0, g_fail = 0;
static const char* g_group = "";

static void group(const char* name) {
  g_group = name;
  printf("\n\033[1m%s\033[0m\n", name);
}

static void ok(bool cond, const char* what) {
  if (cond) {
    g_pass++;
  } else {
    g_fail++;
    printf("  \033[31mFAIL\033[0m %s :: %s\n", g_group, what);
  }
}

static void eqStr(const char* got, const char* want, const char* what) {
  if (got && want && strcmp(got, want) == 0) {
    g_pass++;
    return;
  }
  g_fail++;
  printf("  \033[31mFAIL\033[0m %s :: %s\n", g_group, what);
  printf("        want: %s\n", want ? want : "(null)");
  printf("        got:  %s\n", got ? got : "(null)");
}

static void eqU32(unsigned long got, unsigned long want, const char* what) {
  if (got == want) {
    g_pass++;
    return;
  }
  g_fail++;
  printf("  \033[31mFAIL\033[0m %s :: %s  want=%lu got=%lu\n", g_group, what, want, got);
}

static void toHex(const uint8_t* b, size_t n, char* out) {
  static const char* H = "0123456789abcdef";
  for (size_t i = 0; i < n; i++) {
    out[i * 2] = H[b[i] >> 4];
    out[i * 2 + 1] = H[b[i] & 0xF];
  }
  out[n * 2] = '\0';
}

// ---------------------------------------------------------------- primitives
static void testSha256() {
  group("SHA-256 (NIST vectors)");
  struct { const char* in; const char* want; } v[] = {
    { "", "e3b0c44298fc1c149afbf4c8996fb92427ae41e4649b934ca495991b7852b855" },
    { "abc", "ba7816bf8f01cfea414140de5dae2223b00361a396177a9cb410ff61f20015ad" },
    { "abcdbcdecdefdefgefghfghighijhijkijkljklmklmnlmnomnopnopq",
      "248d6a61d20638b8e5c026930c3e6039a33ce45964ff2167f6ecedd419db06c1" },
  };
  for (size_t i = 0; i < sizeof(v) / sizeof(v[0]); i++) {
    uint8_t d[32];
    char hex[65];
    bsSha256(v[i].in, strlen(v[i].in), d);
    toHex(d, 32, hex);
    eqStr(hex, v[i].want, v[i].in[0] ? v[i].in : "(empty)");
  }
  // A million 'a' — exercises the block buffering across many updates, which is exactly
  // where a hand-written padding routine goes wrong.
  BsSha256 c;
  bsSha256Init(&c);
  for (int i = 0; i < 10000; i++) {
    bsSha256Update(&c, "aaaaaaaaaaaaaaaaaaaaaaaaaaaaaaaaaaaaaaaaaaaaaaaaaaaaaaaaaaaaaaaaaaaaaaaaaaaaaaaaaaaaaaaaaaaaaaaaaaaa", 100);
  }
  uint8_t d[32];
  char hex[65];
  bsSha256Final(&c, d);
  toHex(d, 32, hex);
  eqStr(hex, "cdc76e5c9914fb9281a1c7e284d73e67f1809a48a497200e046d39ccc7112cd0", "1e6 x 'a'");
}

static void testSha1() {
  group("SHA-1 (NIST vectors)");
  struct { const char* in; const char* want; } v[] = {
    { "", "da39a3ee5e6b4b0d3255bfef95601890afd80709" },
    { "abc", "a9993e364706816aba3e25717850c26c9cd0d89d" },
    { "abcdbcdecdefdefgefghfghighijhijkijkljklmklmnlmnomnopnopq",
      "84983e441c3bd26ebaae4aa1f95129e5e54670f1" },
  };
  for (size_t i = 0; i < sizeof(v) / sizeof(v[0]); i++) {
    BsSha1 c;
    uint8_t d[20];
    char hex[41];
    bsSha1Init(&c);
    bsSha1Update(&c, v[i].in, strlen(v[i].in));
    bsSha1Final(&c, d);
    toHex(d, 20, hex);
    eqStr(hex, v[i].want, v[i].in[0] ? v[i].in : "(empty)");
  }
}

static void testHmac() {
  group("HMAC-SHA256 (RFC 4231)");
  uint8_t k1[20];
  memset(k1, 0x0b, sizeof(k1));
  uint8_t d[32];
  char hex[65];
  bsHmacSha256(k1, sizeof(k1), "Hi There", 8, d);
  toHex(d, 32, hex);
  eqStr(hex, "b0344c61d8db38535ca8afceaf0bf12b881dc200c9833da726e9376c2e32cff7", "case 1");

  bsHmacSha256((const uint8_t*)"Jefe", 4, "what do ya want for nothing?", 28, d);
  toHex(d, 32, hex);
  eqStr(hex, "5bdcc146bf60754e6a042426089575c75a003f089d2739839dec58b964ec3843", "case 2");

  // Case 6: a key LONGER than the 64-byte block, which must be hashed first.
  uint8_t k3[131];
  memset(k3, 0xaa, sizeof(k3));
  bsHmacSha256(k3, sizeof(k3), "Test Using Larger Than Block-Size Key - Hash Key First", 54, d);
  toHex(d, 32, hex);
  eqStr(hex, "60e431591ee0b67f0d8a26aacbf5b77f8e0bc6213728c5140546040f0ee37f54", "case 6 (long key)");
}

static void testBase32() {
  group("base32 (RFC 4648, unpadded)");
  struct { const char* in; const char* want; } v[] = {
    { "f", "MY" }, { "fo", "MZXQ" }, { "foo", "MZXW6" },
    { "foob", "MZXW6YQ" }, { "fooba", "MZXW6YTB" }, { "foobar", "MZXW6YTBOI" },
  };
  for (size_t i = 0; i < sizeof(v) / sizeof(v[0]); i++) {
    char out[64];
    bsBase32Encode((const uint8_t*)v[i].in, strlen(v[i].in), out, sizeof(out));
    eqStr(out, v[i].want, v[i].in);
    uint8_t back[64];
    int n = bsBase32Decode(v[i].want, strlen(v[i].want), back, sizeof(back));
    ok(n == (int)strlen(v[i].in) && memcmp(back, v[i].in, (size_t)n) == 0, "round trip");
  }
  uint8_t buf[64];
  // Rejections must match what Python's b32decode refuses, or the two disagree about
  // which packets are malformed.
  ok(bsBase32Decode("A", 1, buf, sizeof(buf)) < 0, "reject len%8==1");
  ok(bsBase32Decode("ABC", 3, buf, sizeof(buf)) < 0, "reject len%8==3");
  ok(bsBase32Decode("ABCDEF", 6, buf, sizeof(buf)) < 0, "reject len%8==6");
  ok(bsBase32Decode("MZXW6===", 8, buf, sizeof(buf)) < 0, "reject padding chars");
  ok(bsBase32Decode("mzxw6", 5, buf, sizeof(buf)) < 0, "reject lower case");
  ok(bsBase32Decode("MZXW1", 5, buf, sizeof(buf)) < 0, "reject '1' (not in alphabet)");
  ok(bsBase32Decode("", 0, buf, sizeof(buf)) < 0, "reject empty");
}

// ---------------------------------------------------------------- the protocol
static void testDeriveKey() {
  group("derive_key vs COVEY");
  for (int i = 0; i < BS_KEY_VEC_N; i++) {
    uint8_t key[32];
    char hex[65];
    bookSyncDeriveKey(BS_KEY_VECS[i].passcode, key);
    toHex(key, 32, hex);
    eqStr(hex, BS_KEY_VECS[i].keyHex, BS_KEY_VECS[i].label);
  }
  // A NULL passcode must behave as "" — COVEY does `passcode or ""`.
  uint8_t a[32], b[32];
  bookSyncDeriveKey(NULL, a);
  bookSyncDeriveKey("", b);
  ok(memcmp(a, b, 32) == 0, "NULL passcode == empty passcode");
}

static void buildRec(const BsRecVec* v, BookSyncRecord* r) {
  bookSyncMakeRecord(r, v->ids, v->nIds, v->spine, v->offset, v->fraction,
                     v->turnedAt, v->dev, v->nonce);
}

static void testCanonicalAndSign() {
  group("canonical + sign vs COVEY");
  for (int i = 0; i < BS_REC_VEC_N; i++) {
    const BsRecVec* v = &BS_REC_VECS[i];
    BookSyncRecord r;
    buildRec(v, &r);

    char canon[BOOKSYNC_CANON_MAX];
    bookSyncCanonical(&r, canon, sizeof(canon));
    eqStr(canon, v->canonical, v->label);

    uint8_t key[32];
    bookSyncDeriveKey(v->passcode, key);
    char mac[BOOKSYNC_MAC_CHARS + 1];
    bookSyncSign(&r, key, mac);
    eqStr(mac, v->mac, v->label);
  }
}

static void testReduce() {
  group("reduce_for_mesh vs COVEY");
  for (int i = 0; i < BS_REC_VEC_N; i++) {
    const BsRecVec* v = &BS_REC_VECS[i];
    BookSyncRecord r, red;
    uint16_t frQ = 0;
    buildRec(v, &r);
    bookSyncReduceForMesh(&r, &red, &frQ);

    eqStr(red.ids[0], v->reducedId, v->label);
    eqStr(red.dev, v->reducedDev, v->label);
    eqU32(red.spine, v->reducedSpine, v->label);
    eqU32(red.offset, v->reducedOffset, v->label);
    eqU32(frQ, v->reducedFrQ, v->label);

    char canon[BOOKSYNC_CANON_MAX];
    bookSyncCanonical(&red, canon, sizeof(canon));
    eqStr(canon, v->reducedCanon, v->label);
  }
}

static void testPackMesh() {
  group("pack_mesh — exact packet bytes vs COVEY");
  for (int i = 0; i < BS_REC_VEC_N; i++) {
    const BsRecVec* v = &BS_REC_VECS[i];
    BookSyncRecord r;
    buildRec(v, &r);
    uint8_t key[32];
    bookSyncDeriveKey(v->passcode, key);
    char text[BOOKSYNC_MESH_TEXT_MAX];
    ok(bookSyncPackMesh(&r, key, text, sizeof(text)), v->label);
    eqStr(text, v->meshText, v->label);
    ok(strlen(text) <= 234, "fits a Meshtastic text packet");
  }
}

static void testUnpackMesh() {
  group("unpack_mesh — parse COVEY's own packets");
  for (int i = 0; i < BS_REC_VEC_N; i++) {
    const BsRecVec* v = &BS_REC_VECS[i];
    uint8_t key[32];
    bookSyncDeriveKey(v->passcode, key);
    BookSyncRecord got;
    if (!bookSyncUnpackMesh(v->meshText, key, &got)) {
      ok(false, v->label);
      continue;
    }
    g_pass++;
    eqStr(got.ids[0], v->reducedId, v->label);
    eqStr(got.dev, v->reducedDev, v->label);
    eqU32(got.spine, v->reducedSpine, v->label);
    eqU32(got.offset, v->reducedOffset, v->label);
    eqU32(got.turnedAt, v->turnedAt, v->label);
    eqStr(got.nonce, v->nonce, v->label);
    eqU32((unsigned long)(got.fraction * 65535.0 + 0.5), v->reducedFrQ, v->label);
  }
}

static void testRoundTrip() {
  group("our pack -> our unpack");
  uint8_t key[32];
  bookSyncDeriveKey("vector-passcode-a", key);
  const char* ids[] = { "id:round-trip", "ta:some-book-some-author", "fp:aabbccddeeff0011" };
  BookSyncRecord r;
  bookSyncMakeRecord(&r, ids, 3, 12, 34567, 0.6180339887, 1754870500, "WiPhone", "0f1e2d3c");
  char text[BOOKSYNC_MESH_TEXT_MAX];
  ok(bookSyncPackMesh(&r, key, text, sizeof(text)), "pack");
  BookSyncRecord back;
  ok(bookSyncUnpackMesh(text, key, &back), "unpack verifies");
  eqStr(back.ids[0], "id:round-trip", "first id survives");
  eqU32(back.spine, 12, "spine");
  eqU32(back.offset, 34567, "offset");
  eqU32(back.turnedAt, 1754870500, "turnedAt");
  eqStr(back.dev, "WiPhone", "device");
  // The fraction is lossy by design (1/65535ths); it must land within one quantum.
  ok(back.fraction > 0.61800 && back.fraction < 0.61805, "fraction within a quantum");

  uint8_t other[32];
  bookSyncDeriveKey("a-different-passcode", other);
  ok(!bookSyncUnpackMesh(text, other, NULL), "wrong passcode rejected");
}

static void testRejections() {
  group("malformed / wrongly-signed packets are dropped");
  for (int i = 0; i < BS_BAD_VEC_N; i++) {
    uint8_t key[32];
    bookSyncDeriveKey(BS_BAD_VECS[i].passcode, key);
    BookSyncRecord out;
    ok(!bookSyncUnpackMesh(BS_BAD_VECS[i].text, key, &out), BS_BAD_VECS[i].label);
  }
}

static void testIsSyncText() {
  group("is_sync_text — chat vs machine traffic");
  for (int i = 0; i < BS_IS_SYNC_N; i++) {
    ok(bookSyncIsSyncText(BS_IS_SYNC[i]), BS_IS_SYNC[i]);
  }
  for (int i = 0; i < BS_NOT_SYNC_N; i++) {
    ok(!bookSyncIsSyncText(BS_NOT_SYNC[i]), BS_NOT_SYNC[i][0] ? BS_NOT_SYNC[i] : "(empty)");
  }
  ok(!bookSyncIsSyncText(NULL), "NULL is not sync text");
}

static void testIdsMatch() {
  group("ids_match — ANY overlap is the same book");
  const char* a[] = { "id:pg-1342", "ta:pride-and-prejudice-jane-austen", "fp:aaaa" };
  const char* b[] = { "ta:pride-and-prejudice-jane-austen", "fp:bbbb" };   // different file
  const char* c[] = { "id:pg-9999", "fp:cccc" };
  ok(bookSyncIdsMatch(a, 3, b, 2), "shared title/author id matches");
  ok(!bookSyncIdsMatch(a, 3, c, 2), "no overlap does not match");
  ok(bookSyncIdsMatch(a, 3, a, 3), "identical matches");

  // The mesh case that actually happens: a peer carrying ONE id against our full list.
  const char* one[] = { "ta:pride-and-prejudice-jane-austen" };
  ok(bookSyncIdsMatch(one, 1, a, 3), "single mesh id matches our list");

  const char* empty[] = { "" };
  ok(!bookSyncIdsMatch(empty, 1, a, 3), "empty id never matches");
}

/* ---- the two defects found in the 2026-09-05 booksync sweep -------------------------- */

static void testLongIdsStillMatchAcrossTheWire() {
  group("a book with a LONG id still syncs (the wire cuts ids to 40 bytes)");

  /* epubSlug builds "ta:" + up to 64 characters, so real ids run to 67 bytes — well past
   * BOOKSYNC_MESH_ID_BYTES. reduce_for_mesh sends only the first 40, and the matcher used a
   * plain strcmp, so for these books sync silently did NOTHING, for ever, on both ends. */
  const char* longId =
      "ta:the-brothers-karamazov-fyodor-dostoevsky-constance-garnett-translation";
  ok(strlen(longId) > BOOKSYNC_MESH_ID_BYTES, "the fixture really is longer than the wire");

  BookSyncRecord full, red;
  const char* mine[] = { longId, "fp:abcdabcd" };
  bookSyncMakeRecord(&full, mine, 2, 3, 100, 0.5, 1000, "COVEY", "abcdabcd");
  bookSyncReduceForMesh(&full, &red, NULL);
  ok(strcmp(red.ids[0], longId) != 0, "the wire id really is truncated");

  ok(bookSyncRecordMatchesIds(&red, mine, 2),
     "the truncated wire id matches our untruncated one");

  // ...and it must NOT match a different book that merely has a long id too.
  const char* other[] = { "ta:crime-and-punishment-fyodor-dostoevsky-constance-garnett-trans" };
  ok(!bookSyncRecordMatchesIds(&red, other, 1), "a different book still does not match");

  // Short ids are unaffected: an exact match is still an exact match, and a miss still misses.
  const char* shortMine[] = { "id:pg-1342" };
  const char* shortOther[] = { "id:pg-9999" };
  ok(bookSyncIdsMatch(shortMine, 1, shortMine, 1), "short id matches itself");
  ok(!bookSyncIdsMatch(shortMine, 1, shortOther, 1), "short ids that differ still do not match");
}

static void testFractionRoundsUpSoAChapterStartStays() {
  group("the fraction quantiser rounds UP, so a chapter start does not fall backwards");

  /* Quantising to 1/65535ths used to truncate. A chapter boundary is an arbitrary real, so
   * the dequantised value landed BELOW it essentially every time — and applyPending() feeds
   * exactly that fraction to epubLocate, which then returns the END OF THE PREVIOUS CHAPTER. */
  const char* ids[] = { "id:x" };
  const double probes[] = { 0.5, 0.333333, 0.123456, 0.987654, 0.000123, 0.75 };
  int below = 0;
  for (unsigned i = 0; i < sizeof(probes) / sizeof(probes[0]); i++) {
    BookSyncRecord full, red;
    bookSyncMakeRecord(&full, ids, 1, 0, 0, probes[i], 1000, "d", "abcdabcd");
    bookSyncReduceForMesh(&full, &red, NULL);
    if (red.fraction + 1e-12 < full.fraction) {
      below++;
    }
  }
  eqU32((unsigned long)below, 0, "no probe quantises to LESS than where the reader actually was");

  // and never past the end, nor below the start
  BookSyncRecord one, oneR, zero, zeroR;
  bookSyncMakeRecord(&one, ids, 1, 0, 0, 1.0, 1000, "d", "abcdabcd");
  bookSyncReduceForMesh(&one, &oneR, NULL);
  ok(oneR.fraction <= 1.0 && oneR.fraction > 0.99999, "1.0 stays 1.0");
  bookSyncMakeRecord(&zero, ids, 1, 0, 0, 0.0, 1000, "d", "abcdabcd");
  bookSyncReduceForMesh(&zero, &zeroR, NULL);
  ok(zeroR.fraction == 0.0, "0.0 stays 0.0");

  /* The overshoot has to stay negligible — this is what makes rounding up the safe direction
   * rather than a different bug. One step is 1/65535 of the whole book. */
  BookSyncRecord mid, midR;
  bookSyncMakeRecord(&mid, ids, 1, 0, 0, 0.5, 1000, "d", "abcdabcd");
  bookSyncReduceForMesh(&mid, &midR, NULL);
  ok(midR.fraction - 0.5 < 1.0 / 65535.0 + 1e-12, "and it never overshoots by more than one step");
}

static void testSuspectClock() {
  group("suspect_clock");
  BookSyncRecord r;
  const char* ids[] = { "id:x" };
  bookSyncMakeRecord(&r, ids, 1, 0, 0, 0.0, 2000000000u, "COVEY", "00000000");
  ok(bookSyncSuspectClock(&r, 1999000000u), "future turn is suspect");
  ok(!bookSyncSuspectClock(&r, 2000000000u), "same time is not suspect");
  ok(!bookSyncSuspectClock(&r, 2000000400u), "past turn is not suspect");
  bookSyncMakeRecord(&r, ids, 1, 0, 0, 0.0, 2000000200u, "COVEY", "00000000");
  ok(!bookSyncSuspectClock(&r, 2000000000u), "200s ahead is inside the 300s allowance");
}

int main() {
  printf("\033[1mbooksync — WiPhone <-> COVEY interop\033[0m\n");
  testSha256();
  testSha1();
  testHmac();
  testBase32();
  testDeriveKey();
  testCanonicalAndSign();
  testReduce();
  testPackMesh();
  testUnpackMesh();
  testRoundTrip();
  testRejections();
  testIsSyncText();
  testIdsMatch();
  testLongIdsStillMatchAcrossTheWire();
  testFractionRoundsUpSoAChapterStartStays();
  testSuspectClock();

  printf("\n%s%d passed, %d failed\033[0m\n",
         g_fail ? "\033[31m" : "\033[32m", g_pass, g_fail);
  return g_fail ? 1 : 0;
}
